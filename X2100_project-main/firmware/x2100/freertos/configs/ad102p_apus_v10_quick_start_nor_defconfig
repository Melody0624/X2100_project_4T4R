## X2100_project-main/firmware/x2100/freertos/configs/x2000_rtos_linux_coexist_nand_defconfig
```kconfig
CONFIG_SPL_BIN_FILE=xburst2/soc-x2000/spl/x2000-spl-sfc-nand-1200M-750M.bin
RTOS_TOOLCHAIN_PATH=../tools/toolchains/mips-xburst2-newlib430/bin
CROSS=mips-sde-elf-
CONFIG_OS_MEM_ADDR=0x86000000
CONFIG_OS_MEM_SIZE=33554432
CONFIG_OS_EXCEPTION_SECTION_SIZE=1024
CONFIG_OS_MAIN_STACK_SIZE=16384
CONFIG_OS_EXCEPTION_STACK_SIZE=2048
CONFIG_SHOW_COMPILE_TIME=y
# CONFIG_OS_HAS_CPP_SUPPORT is not set
CONFIG_OS_GCC_OPTIMIZATION=-Os
CONFIG_MIPS32:=y
# CONFIG_XBURST is not set
CONFIG_XBURST2=y
CONFIG_XBURST2_X2000=y
# CONFIG_XBURST2_X2100 is not set
# CONFIG_XBURST2_CP0_TIMER is not set
CONFIG_XBURST2_MSA=y
CONFIG_SOC_X2000S:=y
CONFIG_SOC_X2000:=y
# CONFIG_X2000_DPU_HAL is not set
CONFIG_SOC_X2000_X2000:=y
# CONFIG_SOC_X2000_X2100 is not set
# CONFIG_SOC_X2000_UART0 is not set
# CONFIG_SOC_X2000_UART1 is not set
CONFIG_SOC_X2000_UART2=y
CONFIG_SOC_X2000_UART2_RX=GPIO_PD(30),GPIO_FUNC_0
CONFIG_SOC_X2000_UART2_TX=GPIO_PD(31),GPIO_FUNC_0
CONFIG_SOC_X2000_UART2_CTS=-1
CONFIG_SOC_X2000_UART2_RTS=-1
# CONFIG_SOC_X2000_UART3 is not set
# CONFIG_SOC_X2000_UART4 is not set
# CONFIG_SOC_X2000_UART5 is not set
# CONFIG_SOC_X2000_UART6 is not set
# CONFIG_SOC_X2000_UART7 is not set
# CONFIG_SOC_X2000_UART8 is not set
# CONFIG_SOC_X2000_UART9 is not set
# CONFIG_X2000_I2C0_BUS is not set
# CONFIG_X2000_I2C1_BUS is not set
CONFIG_X2000_I2C2_BUS=y
CONFIG_X2000_I2C2_PB=y
# CONFIG_X2000_I2C2_PD is not set
# CONFIG_X2000_I2C2_PE is not set
CONFIG_X2000_I2C2_RATE=400000
# CONFIG_X2000_I2C3_BUS is not set
# CONFIG_X2000_I2C4_BUS is not set
CONFIG_X2000_I2C5_BUS=y
CONFIG_X2000_I2C5_PC=y
# CONFIG_X2000_I2C5_PD is not set
CONFIG_X2000_I2C5_RATE=400000
CONFIG_X2000_SPI_CLK_RATE=100000000
# CONFIG_X2000_SPI0 is not set
# CONFIG_X2000_SPI1 is not set
# CONFIG_X2000_LCD is not set
# CONFIG_X2000_FB_LAYER_MIXER is not set
# CONFIG_X2000_CAMERA is not set
# CONFIG_X2000_AIC is not set
# CONFIG_X2000_ICODEC is not set
# CONFIG_X2000_ADC is not set
# CONFIG_X2000_WDT is not set
# CONFIG_X2000_RTC is not set
# CONFIG_X2000_PM is not set
CONFIG_X2000_CONN=y
CONFIG_X2000_CONN_MAX_LINK_COUNT=16
# CONFIG_X2000_CONN_VIC is not set
CONFIG_EXTAL_CLOCK=24000000
# CONFIG_XBURST2_RTC_32K is not set
BITS_PER_LONG=32
CONFIG_XBURST2_IRQ=y
CONFIG_XBURST2_CACHE=y
CONFIG_XBURST2_SPINLOCK=y
CONFIG_XBURST2_CLK=y
CONFIG_XBURST2_SYSTICK=y
CONFIG_XBURST2_GPIO=y
CONFIG_XBURST2_DMA=y
CONFIG_LIB=y
CONFIG_LIB_ASSERT=y
# CONFIG_ASSERT_WITH_NO_FILENAME is not set
CONFIG_LIB_DEALY=y
CONFIG_LIB_RTC=y
CONFIG_LIB_STRING=y
CONFIG_LIB_DUMP_MEM=y
CONFIG_LIB_XFORMAT:=y
CONFIG_LIB_XFORMAT_PRINTF=y
# CONFIG_LIB_RING_BUFFER is not set
CONFIG_DUMP_STACK=y
# CONFIG_LIB_SORT is not set
# CONFIG_IMG_CONVERT is not set
CONFIG_RING_MEM:=y
CONFIG_DRIVERS=y
CONFIG_IRQ:=y
CONFIG_CACHE:=y
CONFIG_SPINLOCK:=y
CONFIG_CLK:=y
CONFIG_SYSTICK:=y
CONFIG_GPIO:=y
CONFIG_REGULATOR:=y
CONFIG_UART:=y
# CONFIG_PM is not set
# CONFIG_FB is not set
CONFIG_DMA:=y
# CONFIG_SPI is not set
CONFIG_I2C:=y
# CONFIG_MMC is not set
# CONFIG_PCM is not set
# CONFIG_ADC is not set
# CONFIG_PWM is not set
# CONFIG_EFUSE is not set
# CONFIG_WDT is not set
# CONFIG_RTC is not set
# CONFIG_DTRNG is not set
# CONFIG_DES is not set
# CONFIG_CAMERA is not set
# CONFIG_ISP is not set
# CONFIG_BACKLIGHT is not set
# CONFIG_MSCALER is not set
CONFIG_CONN:=y
# CONFIG_INPUT is not set
CONFIG_HRTIMER=y
# CONFIG_LCD_GPIO is not set
# CONFIG_GPIO_SPI is not set
CONFIG_GPIO_I2C=y
CONFIG_GPIO_I2C0=y
CONFIG_GPIO_I2C0_ID=6
CONFIG_GPIO_I2C0_SCL=GPIO_PD(4)
CONFIG_GPIO_I2C0_SDA=GPIO_PD(5)
CONFIG_GPIO_I2C0_CLK_RATE=100000
# CONFIG_GPIO_I2C1 is not set
# CONFIG_GPIO_I2C2 is not set
# CONFIG_GPIO_I2C3 is not set
# CONFIG_USB_DRIVER is not set
# CONFIG_SFC is not set
CONFIG_CONSOLE=y
CONFIG_CONSOLE_USE_UART=y
CONFIG_UART_CONSOLE:=y
CONFIG_UART_CONSOLE_UART_ID=2
CONFIG_UART_CONSOLE_BAUD_RATE=3000000
CONFIG_UART_CONSOLE_RX_MODE_POLL=y
# CONFIG_GPIO_PIN is not set
CONFIG_DEVICES=y
# CONFIG_X1000_SLCD_ST7789V is not set
# CONFIG_X1000_SLCD_TRULY240240 is not set
# CONFIG_X1830_TFT_ST7701 is not set
# CONFIG_X1830_SLCD_KWH035 is not set
# CONFIG_X1830_SLCD_ST7789 is not set
# CONFIG_X1021_SLCD_KWH035 is not set
# CONFIG_X2000_MIPI_KD070D57 is not set
# CONFIG_X2000_SLCD_KWH035 is not set
# CONFIG_X2000_SLCD_JD9851 is not set
# CONFIG_GPIO_BACKLIGHT is not set
# CONFIG_PWM_BACKLIGHT is not set
# CONFIG_GPIO_KEYBOARD is not set
# CONFIG_ADC_KEYBOARD is not set
# CONFIG_MATRIX_KEY is not set
# CONFING_GSL1680_TOUCH is not set
# CONFIG_X1000_SENSOR_GC0308 is not set
# CONFIG_X1000_SENSOR_BF20A6 is not set
# CONFIG_X1000_SENSOR_GC2155 is not set
# CONFIG_X1021_SENSOR_GC0328 is not set
# CONFIG_X1021_SENSOR_OV9732 is not set
# CONFIG_X1520_SENSOR_GC2145 is not set
# CONFIG_X1520_SENSOR_OV9281 is not set
# CONFIG_X1520_SENSOR_OV9732 is not set
# CONFIG_X1830_SENSOR_OV2735 is not set
# CONFIG_X1830_SENSOR_IMX307 is not set
# CONFIG_X1830_SENSOR_AR0522 is not set
# CONFIG_X1830_SENSOR_AR0230 is not set
# CONFIG_X2000_SENSOR_GC2053 is not set
# CONFIG_X2000_SENSOR_OV9281 is not set
# CONFIG_CODEC_AK4951 is not set
# CONFIG_EMMC_DEVICE is not set
CONFIG_GPIO_REGULATOR=y
CONFIG_GPIO_REGULATOR0=y
CONFIG_GPIO_REGULATOR0_GPIO=GPIO_PC(12),1
CONFIG_GPIO_REGULATOR0_NAME="regulator_gpio0"
# CONFIG_GPIO_REGULATOR1 is not set
# CONFIG_GPIO_REGULATOR2 is not set
CONFIG_OS=y
CONFIG_OS_FREERTOS=y
# CONFIG_OS_ITOS is not set
# CONFIG_OS_POSIX is not set
# CONFIG_OS_MODULE is not set
CONFIG_NEWLIB=y
CONFIG_SYMBOLS:=y
CONFIG_FUNC_SYMBOLS:=y
CONFIG_DFS=y
# CONFIG_DFS_ELMFAT is not set
# CONFIG_DFS_DEBUGFS is not set
CONFIG_SHELL=y
# CONFIG_NET is not set
# CONFIG_LIBSTDCPP is not set
# CONFIG_LIBCXX is not set
# CONFIG_LIBMAD is not set
# CONFIG_LIBSAMPLERATE is not set
# CONFIG_AF_RESAMPLE is not set
# CONFIG_AWTK is not set
# CONFIG_MEMTESTER is not set
# CONFIG_LIBJPEG is not set
# CONFIG_LIBFACEDET is not set
```

## X2100_project-main/firmware/x2100/freertos/package/Config.in
```kconfig
source package/build/Config.in
source package/mips/Config.in
source package/xburst/Config.in
source package/xburst2/Config.in
source package/lib/Config.in
source package/drivers/Config.in
source package/devices/Config.in
source package/os/Config.in
source package/newlib/Config.in
source package/symbols/Config.in
source package/filesystem/Config.in
source package/shell/Config.in
source package/net/Config.in
source package/secureboot/Config.in
source package/application/Config.in
source package/third_party/Config.in
source package/vendor/Config.in
```

## X2100_project-main/firmware/x2100/freertos/package/application/Config.in
```kconfig
menu "应用程序"

config CONFIG_APPLICATION
    bool

source package/application/face/Config.in

source package/application/load_kernel/Config.in

endmenu
```

## X2100_project-main/firmware/x2100/freertos/package/application/face/Config.in
```kconfig
menuconfig CONFIG_APPLICATION_FACE
    bool "人脸识别"
    select CONFIG_APPLICATION
    select CONFIG_LIBCXX
    select CONFIG_LIBIAAC
    select CONFIG_LIBFACEDET
    default n

config CONFIG_APPLICATION_X2000_ILOCK
    bool "x2000_ilock"
    default n
    help
        "x2000 ilock face"

config CONFIG_APPLICATION_X2000_IR_SC2355
    bool "x2000_ir_sc2355"
    default n
    help
        "x2000 ir sc2355 face"

config CONFIG_APPLICATION_X2000_TOF
    bool "x2000_tof"
    default n
    help
        "x2000 tof face"

endmenu # CONFIG_APPLICATION_FACE
```

## X2100_project-main/firmware/x2100/freertos/package/application/load_kernel/Config.in
```kconfig
config CONFIG_APPLICATION_LOAD_KERNEL
    bool "加载Linux镜像"
    select CONFIG_APPLICATION
    default n
    help
        "RTOS(core-0)加载镜像 SPL(core-0)引导Linux系统"
```

## X2100_project-main/firmware/x2100/freertos/package/build/Config.in
```kconfig
menu "通用选项"

config CONFIG_SPL_BIN_FILE
    string "spl bin文件"
    choice from SOC_SPL_BIN_FILES
    help
        spl bin文件被安放在rtos bin文件头部,用于被cpu识别,并引导rtos

menuconfig CONFIG_COMPRESS_RTOS_BIN
    bool "生成压缩格式的 rtos"

config CONFIG_SPLIT_GZIP_HEADER_NUM
    int "分包最大值"
    default 16

config CONFIG_SPLIT_GZIP_BLOCK_SIZE
    string "包大小"
    default "2M"

config CONFIG_GZIP_SPLIT_RTOS
    bool "gzip 分包压缩"
    default n

config CONFIG_LZMA_SPLIT_RTOS
    bool "lzma 分包压缩"
    default n

endmenu

config RTOS_TOOLCHAIN_PATH
    string "工具链路径"
    default "../tools/toolchains/mips-xburst1-newlib430/bin"
    help
        工具链bin目录路径，多个路径用冒号分隔
        编译时会自动添加到PATH环境变量
        XBurst1架构默认使用: ../tools/toolchains/mips-xburst1-newlib430/bin
        XBurst2架构默认使用: ../tools/toolchains/mips-xburst2-newlib430/bin
        注意：使用RTOS_前缀避免与系统环境变量冲突

config CROSS
    string "gcc 工具链的前缀"
    default mips-sde-elf-
    help
        交叉编译工具链前缀
        XBurst1和XBurst2的newlib工具链使用: mips-sde-elf-
        旧的glibc工具链使用: mips-linux-gnu-

config CONFIG_OS_MEM_ADDR
    int "固件加载的地址"
    default 0x80100000

config CONFIG_OS_MEM_SIZE
    int "固件使用的内存大小"
    default 0

config CONFIG_OS_EXCEPTION_SECTION_SIZE
    int "异常向量表大小"
    default 1024

config CONFIG_OS_MAIN_STACK_SIZE
    int "初始化栈大小"
    default 16384

config CONFIG_OS_EXCEPTION_STACK_SIZE
    int "异常栈大小"
    default 2048

config CONFIG_JTAG_DEBUG
    bool "使用JTAG 调试程序(x1600)"
    default n

config CONFIG_SHOW_COMPILE_TIME
    bool "开机时显示编译的时间"
    default y

config CONFIG_KERNEL_WAIT_RTOS_STOP
    bool "bootloader 等待 rtos 运行结束,然后执行 linux"
    default n

config CONFIG_OS_HAS_CPP_SUPPORT
    bool

array CONFIG_OS_GCC_OPTIMIZATIONS
    string "gcc 优化选项"
    item "-O0" "-O0"
    item "-O1" "-O1"
    item "-O2" "-O2"
    item "-O3" "-O3"
    item "-Os" "-Os"
    item "-Ofast" "-Ofast"

config CONFIG_OS_GCC_OPTIMIZATION
    string "gcc 优化选项"
    choice from CONFIG_OS_GCC_OPTIMIZATIONS
    default -Os

config CONFIG_FPU_ALWAYS_ON
    bool "fpu 一直使能 (且中断中也可使用)"
    default n

config CONFIG_ENABLE_NESTED_IRQ
    bool "使能中断嵌套(支持ost中断高优先级)"
    default n

menuconfig CONFIG_TCSM_SECTION
    bool "使用tcsm功能"
    default n

config CONFIG_TCSM_SECTION_ADDR
    int "tcsm 起始地址"
    default 0xb3422000

config CONFIG_TCSM_SECTION_SIZE
    int "tcsm 大小"
    default 32768

config CONFIG_TCSM_SECTION_IRQ
    bool "中断处理函数入口放到tcsm中"
    default y

config CONFIG_TCSM_SECTION_HRTIMER
    bool "hrtimer 的中断处理函数放入tcsm中"
    default y

config CONFIG_TCSM_SECTION_OST
    bool "OST 的中断处理函数放入tcsm中"
    default y

endmenu

endmenu
```

## X2100_project-main/firmware/x2100/freertos/package/devices/Config.in
```kconfig
menuconfig CONFIG_DEVICES
    bool "外设"

source "package/devices/lcd/lcd.in"
source "package/devices/backlight/backlight.in"
source "package/devices/keyboard/keyboard.in"
source "package/devices/touch/touch.in"
source "package/devices/camera/camera.in"
source "package/devices/codec/codec.in"
source "package/devices/mmc/mmc.in"
source "package/devices/ramdisk/ramdisk.in"
source "package/devices/regulator/regulator.in"
source "package/devices/wireless/Config.in"
source "package/devices/afe/afe.in"
source "package/devices/cis/cis.in"

endmenu # CONFIG_DEVICES
```

## X2100_project-main/firmware/x2100/freertos/package/devices/lcd/ilcdtools/config.in
```kconfig
menuconfig CONFIG_LCD_ILCDTOOLS
    bool "通用 lcd 驱动"
    select CONFIG_GPIO_BACKLIGHT
    select CONFIG_PWM_BACKLIGHT
    select CONFIG_GPIO_REGULATOR
    select CONFIG_GPIO_PIN
    default n

choice "选择固件形式"
    default MD_LCD_ILCDTOOLS_BIN
config MD_LCD_ILCDTOOLS_BIN
    bool "将 bin 包含进 rtos"
config MD_LCD_ILCDTOOLS_FLASH_BIN
    bool "将 bin 烧录到flash"
endchoice

config MD_LCD_ILCDTOOLS_BIN_NAME
    string "配置文件名（需要放在 rtos 根目录下）"
    default "lcdbin"
    depends on MD_LCD_ILCDTOOLS_BIN

config MD_LCD_ILCDTOOLS_FLASH_BIN_NAME
    string "配置所在的分区名"
    default "lcd"
    depends on MD_LCD_ILCDTOOLS_FLASH_BIN

endmenu
```

## X2100_project-main/firmware/x2100/freertos/package/devices/wireless/Config.in
```kconfig
menu "WiFi设备列表"

config CONFIG_DEVICES_WIRELESS
    bool
    default n


source "package/devices/wireless/infineonwhd/Config.in"

source "package/devices/wireless/atbm/Config.in"

endmenu
```

## X2100_project-main/firmware/x2100/freertos/package/devices/wireless/atbm/Config.in
```kconfig
menuconfig CONFIG_WIRELESS_ATBM
    bool "Altobeam WiFi Host Driver"
    depends on CONFIG_MMC
    select CONFIG_DEVICES_WIRELESS

config CONFIG_WIRELESS_ATBM_BUSNUM
    int "wifi mmc num(mmc/sdio 总线号)"
    default -1
    help
        WiFi外设挂接在哪个mmc总线,

array WIRELESS_ATBM_DEVICE
    string "wifi 选择型号"
    item "wifi 选择atbm6031-x" 0x6031
    item "wifi 选择atbm6132" 0x6132

config CONFIG_WIRELESS_ATBM_DEVICE
    string "wifi 选择型号"
    choice from WIRELESS_ATBM_DEVICE
    default 0x6031

config CONFIG_WIRELESS_ATBM_BT_WIFI_POWER
    string "gpio bt wifi power on(控制整个bt,wifi模块的供电)"
    default -1,0
    choice from SOC_GPIO_PIN_LEVELS

config CONFIG_WIRELESS_ATBM_WLAN_REG_ON
    string "gpio wlan reg on(wifi使能引脚)"
    default -1,0
    choice from SOC_GPIO_PIN_LEVELS

config CONFIG_WIRELESS_ATBM_WLAN_WAKE_HOST
    string "gpio wlan wake host (wifi 唤醒/中断 主控的引导)"
    default -1
    choice from SOC_GPIO_PIN_LEVELS

array WIRELESS_ATBM_IRQ
    string "wifi 选择中断方式"
    item "wifi 选择sdio中断" 0x0
    item "wifi 选择gpio中断" 0x1

config CONFIG_WIRELESS_ATBM_IRQ
    string "wifi 选择中断方式"
    choice from WIRELESS_ATBM_IRQ
    default 0x0

config CONFIG_WIRELESS_ATBM_IRQ_GPIO
    string "gpio wifi irq (wifi gpio中断引脚)"
    default -1
    choice from SOC_GPIO_PINS

endmenu
```

## X2100_project-main/firmware/x2100/freertos/package/devices/wireless/infineonwhd/Config.in
```kconfig
menuconfig CONFIG_WIRELESS_INFINEON_CYWWHD
    bool "Infineon WiFi Host Driver"
    depends on CONFIG_MMC
    select CONFIG_DEVICES_WIRELESS

config CONFIG_WIRELESS_INFINEON_CYWWHD_BUSNUM
    int "wifi mmc num(mmc/sdio 总线号)"
    default -1
    help
        WiFi外设挂接在哪个mmc总线,


config CONFIG_WIRELESS_INFINEON_CYWWHD_BT_WIFI_POWER
    string "gpio bt wifi power on(控制整个bt,wifi模块的供电)"
    default -1,0
    choice from SOC_GPIO_PIN_LEVELS

config CONFIG_WIRELESS_INFINEON_CYWWHD_WLAN_REG_ON
    string "gpio wlan reg on(wifi使能引脚)"
    default -1,0
    choice from SOC_GPIO_PIN_LEVELS

config CONFIG_WIRELESS_INFINEON_CYWWHD_WLAN_WAKE_HOST
    string "gpio wlan wake host (wifi 唤醒/中断 主控的引导)"
    default -1
    choice from SOC_GPIO_PIN_LEVELS

config CONFIG_WIRELESS_INFINEON_CYWWHD_FW_PATH
    string "wifi 固件路径"
    default "devices/wireless/infineonwhd/firmware/cyw43438.bin"

config CONFIG_WIRELESS_INFINEON_CYWWHD_NVRAM_PATH
    string "wifi NVRAM路径"
    default "devices/wireless/infineonwhd/firmware/nvraw.txt"

endmenu
```
