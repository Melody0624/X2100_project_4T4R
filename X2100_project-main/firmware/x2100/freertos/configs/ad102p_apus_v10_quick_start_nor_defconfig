## X2100_project-main/firmware/x2100/freertos/configs/jtag_debug_x1600mn_nor_defconfig
```kconfig
CONFIG_SPL_BIN_FILE=xburst/soc-x1600/spl/x1600mn-spl-sfc-nor-1104M-350M.bin
RTOS_TOOLCHAIN_PATH=../tools/toolchains/mips-xburst1-newlib430/bin
CROSS=mips-sde-elf-
CONFIG_OS_MEM_ADDR=0x80010000
CONFIG_OS_MEM_SIZE=0x1000000
CONFIG_OS_EXCEPTION_SECTION_SIZE=1024
CONFIG_OS_MAIN_STACK_SIZE=17408
CONFIG_OS_EXCEPTION_STACK_SIZE=2048
CONFIG_JTAG_DEBUG=y
CONFIG_SHOW_COMPILE_TIME=y
# CONFIG_KERNEL_WAIT_RTOS_STOP is not set
# CONFIG_OS_HAS_CPP_SUPPORT is not set
CONFIG_OS_GCC_OPTIMIZATION="-O0"
CONFIG_MIPS32:=y
CONFIG_XBURST=y
# CONFIG_XBURST_X1000 is not set
# CONFIG_XBURST_X1500L is not set
# CONFIG_XBURST_X1500 is not set
# CONFIG_XBURST_X1021 is not set
# CONFIG_XBURST_X1521 is not set
# CONFIG_XBURST_X1520 is not set
CONFIG_XBURST_X1600=y
# CONFIG_XBURST_X1660 is not set
# CONFIG_XBURST_X1630 is not set
# CONFIG_XBURST_X1830 is not set
CONFIG_CP0_TIMER=y
# CONFIG_SOC_X1000S is not set
# CONFIG_SOC_X1000 is not set
# CONFIG_SOC_X1021S is not set
# CONFIG_SOC_X1021 is not set
# CONFIG_SOC_X1520 is not set
CONFIG_SOC_X1600S:=y
CONFIG_SOC_X1600:=y
CONFIG_SOC_X1600_X1600:=y
# CONFIG_SOC_X1600_X1660 is not set
CONFIG_SOC_X1600_UART0=y
CONFIG_SOC_X1600_UART0_RX=GPIO_PB(7),GPIO_FUNC_0
CONFIG_SOC_X1600_UART0_TX=GPIO_PB(8),GPIO_FUNC_0
CONFIG_SOC_X1600_UART0_CTS=-1
CONFIG_SOC_X1600_UART0_RTS=-1
# CONFIG_SOC_X1600_UART1 is not set
# CONFIG_SOC_X1600_UART2 is not set
# CONFIG_SOC_X1600_UART3 is not set
CONFIG_SOC_X1600_UART:=y
# CONFIG_SOC_X1660_UART is not set
# CONFIG_X1600_I2C0_BUS is not set
# CONFIG_X1600_I2C1_BUS is not set
CONFIG_X1600_SPI_CLK_RATE=100000000
# CONFIG_X1600_SPI0 is not set
# CONFIG_X1600_SSLV0 is not set
# CONFIG_SOC_X1600_MSC0_BUS is not set
# CONFIG_SOC_X1600_MSC1_BUS is not set
# CONFIG_X1600_CAMERA is not set
# CONFIG_X1600_LCD is not set
# CONFIG_X1600_UTILS is not set
# CONFIG_X1600_PWM is not set
# CONFIG_X1600_ADC is not set
# CONFIG_X1600_WDT is not set
# CONFIG_X1600_RTC is not set
# CONFIG_X1600_EFUSE is not set
# CONFIG_X1600_PM is not set
# CONFIG_X1600_TCU is not set
# CONFIG_SOC_X1830S is not set
# CONFIG_SOC_X1830 is not set
CONFIG_EXTAL_CLOCK=24000000
# CONFIG_XBURST_RTC_32K is not set
BITS_PER_LONG=32
CONFIG_XBURST_IRQ=y
CONFIG_XBURST_CACHE=y
CONFIG_XBURST_SPINLOCK=y
CONFIG_XBURST_CLK=y
CONFIG_XBURST_SYSTICK=y
CONFIG_XBURST_GPIO=y
CONFIG_XBURST_DMA=y
# CONFIG_XBURST2 is not set
CONFIG_LIB=y
CONFIG_LIB_ASSERT=y
# CONFIG_ASSERT_WITH_NO_FILENAME is not set
CONFIG_LIB_DEALY=y
CONFIG_LIB_RTC=y
CONFIG_LIB_STRING=y
CONFIG_LIB_DUMP_MEM=y
CONFIG_LIB_XFORMAT:=y
CONFIG_LIB_XFORMAT_PRINTF=y
# CONFIG_LIB_RING_BUFFER is not set
CONFIG_DUMP_STACK=y
# CONFIG_LIB_SORT is not set
# CONFIG_IMG_CONVERT is not set
# CONFIG_RING_MEM is not set
CONFIG_DRIVERS=y
CONFIG_IRQ=y
CONFIG_CACHE=y
CONFIG_SPINLOCK=y
CONFIG_CLK=y
CONFIG_SYSTICK=y
CONFIG_GPIO=y
# CONFIG_REGULATOR is not set
CONFIG_UART=y
# CONFIG_PM is not set
# CONFIG_ROTATOR is not set
# CONFIG_FB is not set
CONFIG_DMA:=y
# CONFIG_SPI is not set
# CONFIG_SSLV is not set
# CONFIG_I2C is not set
# CONFIG_MMC is not set
# CONFIG_RAMDISK is not set
# CONFIG_PCM is not set
# CONFIG_ADC is not set
# CONFIG_AES is not set
# CONFIG_PWM is not set
# CONFIG_EFUSE is not set
# CONFIG_WDT is not set
# CONFIG_RTC is not set
# CONFIG_DTRNG is not set
# CONFIG_HASH is not set
# CONFIG_DES is not set
# CONFIG_CAMERA is not set
# CONFIG_ISP is not set
# CONFIG_BACKLIGHT is not set
# CONFIG_MSCALER is not set
# CONFIG_CONN is not set
# CONFIG_INPUT is not set
CONFIG_HRTIMER=y
# CONFIG_LCD_GPIO is not set
# CONFIG_GPIO_SPI is not set
# CONFIG_GPIO_I2C is not set
# CONFIG_USB_DRIVER is not set
# CONFIG_SFC is not set
CONFIG_CONSOLE=y
CONFIG_CONSOLE_USE_UART=y
CONFIG_UART_CONSOLE:=y
CONFIG_UART_CONSOLE_UART_ID=0
CONFIG_UART_CONSOLE_BAUD_RATE=3000000
# CONFIG_UART_CONSOLE_RX_MODE_POLL is not set
CONFIG_GPIO_PIN=y
# CONFIG_DEVICES is not set
CONFIG_OS=y
CONFIG_OS_FREERTOS=y
# CONFIG_OS_ITOS is not set
CONFIG_OS_POSIX=y
CONFIG_OS_POSIX_PTHREAD=y
CONFIG_OS_POSIX_PTHREAD_MUTEX=y
CONFIG_OS_POSIX_PTHREAD_COND=y
CONFIG_OS_POSIX_PTHREAD_BARRIER=y
CONFIG_OS_POSIX_SEM=y
CONFIG_OS_POSIX_MQEUEUE=y
CONFIG_OS_POSIX_TIMER=y
CONFIG_OS_POSIX_CLOCK=y
CONFIG_OS_POSIX_SCHED=y
# CONFIG_OS_MODULE is not set
CONFIG_NEWLIB=y
CONFIG_SYMBOLS:=y
CONFIG_FUNC_SYMBOLS:=y
CONFIG_DFS=y
CONFIG_DFS_ELMFAT=y
# CONFIG_DFS_ELMFAT_MOUNT_PARTITION0 is not set
# CONFIG_DFS_ELMFAT_MOUNT_PARTITION1 is not set
# CONFIG_DFS_ELMFAT_MOUNT_PARTITION2 is not set
# CONFIG_DFS_ELMFAT_MOUNT_PARTITION3 is not set
# CONFIG_DFS_ELMFAT_MOUNT_PARTITION4 is not set
# CONFIG_DFS_ELMFAT_MOUNT_PARTITION5 is not set
# CONFIG_DFS_ELMFAT_MOUNT_PARTITION6 is not set
# CONFIG_DFS_ELMFAT_MOUNT_PARTITION7 is not set
CONFIG_DFS_DEBUGFS=y
# CONFIG_DFS_HOTPLUG is not set
# CONFIG_CONN_FS is not set
CONFIG_SHELL=y
# CONFIG_NET is not set
# CONFIG_APPLICATION is not set
# CONFIG_APPLICATION_FACE is not set
# CONFIG_LIBSTDCPP is not set
# CONFIG_LIBCXX is not set
# CONFIG_LIBCXX_RTTI is not set
# CONFIG_LIBMAD is not set
# CONFIG_LIBSAMPLERATE is not set
# CONFIG_AF_RESAMPLE is not set
# CONFIG_AWTK is not set
# CONFIG_MEMTESTER is not set
# CONFIG_LIBJPEG is not set
# CONFIG_JPEG_TURBO is not set
# CONFIG_JPEG_TINY is not set
# CONFIG_LIBFACEDET is not set
# CONFIG_LIBIAAC is not set
# CONFIG_LIBGOODIXTOF is not set
```

## X2100_project-main/firmware/x2100/freertos/configs/x2000_boot_logo_example_defconfig
```kconfig
CONFIG_SPL_BIN_FILE=xburst2/soc-x2000/spl/x2000-spl-sfc-nand-1200M-750M.bin
RTOS_TOOLCHAIN_PATH=../tools/toolchains/mips-xburst2-newlib430/bin
CROSS=mips-sde-elf-
CONFIG_OS_MEM_ADDR=0x86000000
CONFIG_OS_MEM_SIZE=16388608
CONFIG_OS_EXCEPTION_SECTION_SIZE=1024
CONFIG_OS_MAIN_STACK_SIZE=16384
CONFIG_OS_EXCEPTION_STACK_SIZE=2048
CONFIG_SHOW_COMPILE_TIME=y
CONFIG_KERNEL_WAIT_RTOS_STOP=y
# CONFIG_OS_HAS_CPP_SUPPORT is not set
CONFIG_OS_GCC_OPTIMIZATION=-Os
CONFIG_MIPS32:=y
# CONFIG_XBURST is not set
CONFIG_XBURST2=y
CONFIG_XBURST2_X2000=y
# CONFIG_XBURST2_X2100 is not set
# CONFIG_XBURST2_CP0_TIMER is not set
# CONFIG_XBURST2_MSA is not set
CONFIG_SOC_X2000S:=y
CONFIG_SOC_X2000:=y
CONFIG_X2000_DPU_HAL:=y
CONFIG_SOC_X2000_X2000:=y
# CONFIG_SOC_X2000_X2100 is not set
# CONFIG_SOC_X2000_UART0 is not set
# CONFIG_SOC_X2000_UART1 is not set
CONFIG_SOC_X2000_UART2=y
CONFIG_SOC_X2000_UART2_RX=GPIO_PD(30),GPIO_FUNC_0
CONFIG_SOC_X2000_UART2_TX=GPIO_PD(31),GPIO_FUNC_0
CONFIG_SOC_X2000_UART2_CTS=-1
CONFIG_SOC_X2000_UART2_RTS=-1
# CONFIG_SOC_X2000_UART3 is not set
# CONFIG_SOC_X2000_UART4 is not set
# CONFIG_SOC_X2000_UART5 is not set
# CONFIG_SOC_X2000_UART6 is not set
# CONFIG_SOC_X2000_UART7 is not set
# CONFIG_SOC_X2000_UART8 is not set
# CONFIG_SOC_X2000_UART9 is not set
# CONFIG_X2000_I2C0_BUS is not set
# CONFIG_X2000_I2C1_BUS is not set
# CONFIG_X2000_I2C2_BUS is not set
# CONFIG_X2000_I2C3_BUS is not set
# CONFIG_X2000_I2C4_BUS is not set
# CONFIG_X2000_I2C5_BUS is not set
CONFIG_X2000_SPI_CLK_RATE=100000000
# CONFIG_X2000_SPI0 is not set
# CONFIG_X2000_SPI1 is not set
CONFIG_X2000_LCD=y
# CONFIG_X2000_LCD_PAN_DISPLAY_SYNC is not set
CONFIG_X2000_LCD_FB0_ENABLE=y
CONFIG_X2000_LCD_FB0_FRM_CNT=2
CONFIG_X2000_LCD_FB0_NAME="fb0"
# CONFIG_X2000_LCD_FB1_ENABLE is not set
# CONFIG_X2000_LCD_FB2_ENABLE is not set
# CONFIG_X2000_LCD_FB3_ENABLE is not set
# CONFIG_X2000_LCD_FB_SRDMA_ENABLE is not set
# CONFIG_X2000_LCD_FB_MIXER_ENABLE is not set
# CONFIG_X2000_FB_LAYER_MIXER is not set
# CONFIG_X2000_CAMERA is not set
# CONFIG_X2000_AIC is not set
# CONFIG_X2000_ICODEC is not set
# CONFIG_X2000_ADC is not set
# CONFIG_X2000_WDT is not set
CONFIG_EXTAL_CLOCK=24000000
# CONFIG_XBURST2_RTC_32K is not set
BITS_PER_LONG=32
CONFIG_XBURST2_IRQ=y
CONFIG_XBURST2_CACHE=y
CONFIG_XBURST2_SPINLOCK=y
CONFIG_XBURST2_CLK=y
CONFIG_XBURST2_SYSTICK=y
CONFIG_XBURST2_GPIO=y
CONFIG_XBURST2_DMA=y
CONFIG_LIB=y
CONFIG_LIB_ASSERT=y
# CONFIG_ASSERT_WITH_NO_FILENAME is not set
CONFIG_LIB_DEALY=y
CONFIG_LIB_RTC=y
CONFIG_LIB_STRING=y
CONFIG_LIB_DUMP_MEM=y
CONFIG_LIB_XFORMAT:=y
CONFIG_LIB_XFORMAT_PRINTF=y
# CONFIG_LIB_RING_BUFFER is not set
CONFIG_DUMP_STACK=y
# CONFIG_LIB_SORT is not set
CONFIG_IMG_CONVERT=y
# CONFIG_YUV422_TO_RGB is not set
# CONFIG_BAYER16_TO_RGB is not set
CONFIG_CMYK_TO_RGB=y
CONFIG_DRIVERS=y
CONFIG_IRQ:=y
CONFIG_CACHE:=y
CONFIG_SPINLOCK:=y
CONFIG_CLK:=y
CONFIG_SYSTICK:=y
CONFIG_GPIO:=y
# CONFIG_REGULATOR is not set
CONFIG_UART:=y
# CONFIG_PM is not set
CONFIG_FB:=y
CONFIG_DMA:=y
# CONFIG_SPI is not set
# CONFIG_I2C is not set
# CONFIG_MMC is not set
# CONFIG_PCM is not set
# CONFIG_ADC is not set
# CONFIG_PWM is not set
# CONFIG_EFUSE is not set
# CONFIG_WDT is not set
# CONFIG_RTC is not set
# CONFIG_DTRNG is not set
# CONFIG_DES is not set
# CONFIG_CAMERA is not set
# CONFIG_ISP is not set
CONFIG_BACKLIGHT:=y
# CONFIG_MSCALER is not set
# CONFIG_INPUT is not set
CONFIG_HRTIMER=y
CONFIG_LCD_GPIO=y
# CONFIG_GPIO_SPI is not set
# CONFIG_GPIO_I2C is not set
# CONFIG_USB_DRIVER is not set
# CONFIG_SFC is not set
CONFIG_CONSOLE=y
CONFIG_CONSOLE_USE_UART=y
CONFIG_UART_CONSOLE:=y
CONFIG_UART_CONSOLE_UART_ID=2
CONFIG_UART_CONSOLE_BAUD_RATE=3000000
CONFIG_GPIO_PIN=y
CONFIG_DEVICES=y
# CONFIG_X1000_SLCD_ST7789V is not set
# CONFIG_X1000_SLCD_TRULY240240 is not set
# CONFIG_X1830_TFT_ST7701 is not set
# CONFIG_X1830_SLCD_KWH035 is not set
# CONFIG_X1830_SLCD_ST7789 is not set
# CONFIG_X1021_SLCD_KWH035 is not set
CONFIG_X2000_MIPI_KD070D57=y
CONFIG_X2000_KD070D57_BACKLIGHT_EN=-1
CONFIG_X2000_KD070D57_RST=GPIO_PB(0),1
CONFIG_X2000_KD070D57_POWER_EN=GPIO_PB(4),0
# CONFIG_X2000_SLCD_KWH035 is not set
CONFIG_GPIO_BACKLIGHT=y
CONFIG_GPIO_BACKLIGHT0=y
CONFIG_GPIO_BACKLIGHT0_GPIO=GPIO_PC(0),1
CONFIG_GPIO_BACKLIGHT0_NAME="backlight_gpio0"
# CONFIG_GPIO_BACKLIGHT1 is not set
# CONFIG_GPIO_BACKLIGHT2 is not set
# CONFIG_PWM_BACKLIGHT is not set
# CONFIG_GPIO_KEYBOARD is not set
# CONFIG_ADC_KEYBOARD is not set
# CONFIG_MATRIX_KEY is not set
# CONFING_GSL1680_TOUCH is not set
# CONFIG_X1000_SENSOR_GC0308 is not set
# CONFIG_X1000_SENSOR_BF20A6 is not set
# CONFIG_X1000_SENSOR_GC2155 is not set
# CONFIG_X1021_SENSOR_GC0328 is not set
# CONFIG_X1021_SENSOR_OV9732 is not set
# CONFIG_X1520_SENSOR_GC2145 is not set
# CONFIG_X1520_SENSOR_OV9281 is not set
# CONFIG_X1520_SENSOR_OV9732 is not set
# CONFIG_X1830_SENSOR_OV2735 is not set
# CONFIG_X1830_SENSOR_IMX307 is not set
# CONFIG_X1830_SENSOR_AR0522 is not set
# CONFIG_X1830_SENSOR_AR0230 is not set
# CONFIG_X2000_SENSOR_GC2053 is not set
# CONFIG_X2000_SENSOR_OV9281 is not set
# CONFIG_CODEC_AK4951 is not set
# CONFIG_EMMC_DEVICE is not set
# CONFIG_GPIO_REGULATOR is not set
CONFIG_OS=y
CONFIG_OS_FREERTOS=y
# CONFIG_OS_POSIX is not set
# CONFIG_OS_MODULE is not set
CONFIG_NEWLIB=y
CONFIG_SYMBOLS:=y
CONFIG_FUNC_SYMBOLS:=y
CONFIG_DFS:=y
# CONFIG_DFS_ELMFAT is not set
# CONFIG_DFS_DEBUGFS is not set
# CONFIG_SHELL is not set
# CONFIG_NET is not set
# CONFIG_LIBSTDCPP is not set
# CONFIG_LIBCXX is not set
# CONFIG_LIBMAD is not set
# CONFIG_LIBSAMPLERATE is not set
# CONFIG_AF_RESAMPLE is not set
# CONFIG_AWTK is not set
# CONFIG_MEMTESTER is not set
CONFIG_LIBJPEG=y
```
