## X2100_project-main/firmware/x2100/freertos/package/drivers/Config.in
```kconfig
menuconfig CONFIG_DRIVERS
    bool "驱动"

config CONFIG_IRQ
    bool

config CONFIG_CACHE
    bool

config CONFIG_SPINLOCK
    bool

config CONFIG_CLK
    bool

config CONFIG_SYSTICK
    bool

config CONFIG_GPIO
    bool

config CONFIG_REGULATOR
    bool

config CONFIG_UART
    bool

config CONFIG_PM
    bool

config CONFIG_ROTATOR
    bool

config CONFIG_FB
    bool

config CONFIG_DMA
    bool

config CONFIG_SPI
    bool

config CONFIG_SSLV
    bool

config CONFIG_I2C
    bool

config CONFIG_MMC
    bool

config CONFIG_RAMDISK
    bool

config CONFIG_PCM
    bool

config CONFIG_ADC
    bool

config CONFIG_AES
    bool

config CONFIG_SECURITY_AES
    bool

config CONFIG_PWM
    bool

config CONFIG_EFUSE
    bool

config CONFIG_EFUSE_MODE_HAMMING
    bool

config CONFIG_EFUSE_MODE_NONE
    bool

config CONFIG_WDT
    bool

config CONFIG_RTC
    bool

config CONFIG_DTRNG
    bool

config CONFIG_HASH
    bool

config CONFIG_DES
    bool

config CONFIG_MAC
    bool

config CONFIG_CAN
    bool

config CONFIG_CAMERA
    bool

config CONFIG_ISP
    bool

config CONFIG_BACKLIGHT
    bool

config CONFIG_MSCALER
    bool

config CONFIG_CONN
    bool

config CONFIG_SCBOOT_DRIVER
    bool

config CONFIG_INPUT
    bool
    select CONFIG_LIB_RING_BUFFER

config CONFIG_HRTIMER
    bool "高精度定时器"
    select CONFIG_SYSTICK

config CONFIG_LCD_GPIO
    bool "LCD_GPIO驱动(提供8080时序读写接口)"

source package/drivers/gpio_spi.in

source package/drivers/gpio_i2c.in

source "package/drivers/usb/usb.in"

menuconfig CONFIG_SFC
    bool "SFC驱动"

choice "选择存储介质"
    default CONFIG_SFC_NOR

config CONFIG_SFC_NOR
    bool "NorFlash存储介质"

config CONFIG_SFC_NAND
    bool "NandFlash存储介质"

endchoice

config CONFIG_SFC_RATE
    int "sfc时钟频率"
    default 100000000

config CONFIG_EXTRA_NOR_INFO_OFF
    int "sfc nor 额外的信息列表(用于单个固件匹配多个nor设备)"
    default 0x5c00
    depends on CONFIG_SFC_NOR

config CONFIG_SFC_NAND_JUMP_CHECK_BADBLOCK
    bool "NandFlash 跳过检测坏块"
    depends on CONFIG_SFC_NAND

endmenu # CONFIG_SFC

menuconfig CONFIG_RTOS_OTA_UPDATE
    bool "rtos 的ota升级"
    select CONFIG_LIB_CRC32

choice "选择OTA升级的存储介质"

config CONFIG_OTA_SFC_NOR
    bool "NorFlash存储介质"
    depends on CONFIG_SFC_NOR

config CONFIG_OTA_SFC_NAND
    bool "NandFlash存储介质"
    depends on CONFIG_SFC_NAND

config CONFIG_OTA_MMC
    bool "mmc存储介质"
    depends on CONFIG_EMMC_DEVICE

endchoice

endmenu #CONFIG_RTOS_OTA_UPDATE

menuconfig CONFIG_OTA_AB_UPGRADE
    bool "AB分区ota升级"
    select CONFIG_LIB_CRC32

choice "选择AB分区OTA升级的存储介质"

config CONFIG_OTA_AB_SFC_NOR
    bool "NorFlash存储介质"
    depends on CONFIG_SFC_NOR

config CONFIG_OTA_AB_SFC_NAND
    bool "NandFlash存储介质"
    depends on CONFIG_SFC_NAND

config CONFIG_OTA_AB_MMC
    bool "mmc存储介质"
    depends on CONFIG_EMMC_DEVICE

endchoice

endmenu #CONFIG_OTA_AB_UPGRADE

menuconfig CONFIG_CONSOLE
    bool "console 驱动(主要用于printf输出)"
    default y

choice "选择 console device"
    default CONFIG_CONSOLE_USE_UART

config CONFIG_CONSOLE_USE_UART
    bool "uart console"
    select CONFIG_UART_CONSOLE

endchoice

menuconfig CONFIG_UART_CONSOLE
    bool "uart 作为console device"
    depends on CONFIG_CONSOLE_USE_UART

config CONFIG_UART_CONSOLE_UART_ID
    int "uart id"
    choice from SOC_UART_DEVICES

config CONFIG_UART_CONSOLE_BAUD_RATE
    int "uart 波特率"
    default 115200
    choice from SOC_UART_BAUD_RATES

config CONFIG_UART_CONSOLE_RX_MODE_POLL
    bool "uart 使用轮询接收模式"
    default n
    help
        "当Linux和RTOS同时存在时,只能使用轮询模式"

endmenu # CONFIG_UART_CONSOLE

endmenu # CONFIG_CONSOLE

source package/drivers/utils.in
source package/drivers/pwm_scanner.in

menuconfig CONFIG_PWM_AUDIO
    bool "PWM 音频播放"
    select CONFIG_LIBSAMPLERATE
    default n

config CONFIG_PWM_AUDIO_GPIO
    string "PWM 音频输出脚"
    default -1
    choice from SOC_GPIO_PINS

config CONFIG_PWM_AUDIO_GPIO_AMP_ENABLE
    string "功放使能脚"
    default -1
    choice from SOC_GPIO_PINS
endmenu

endmenu # CONFIG_DRVIERS
```

## X2100_project-main/firmware/x2100/freertos/package/filesystem/Config.in
```kconfig
menuconfig CONFIG_DFS
    bool "设备文件系统"

source "package/filesystem/fat.in"
source "package/filesystem/debugfs.in"
source "package/filesystem/hotplug.in"
source "package/filesystem/uffs.in"
source "package/filesystem/yaffs.in"

config CONFIG_CONN_FS
    bool
    default n

endmenu
```

## X2100_project-main/firmware/x2100/freertos/package/lib/Config.in
```kconfig
menuconfig CONFIG_LIB
    bool "通用库函数"

config CONFIG_LIB_ASSERT
    bool "断言函数(assert)"
    default y

config CONFIG_ASSERT_WITH_NO_FILENAME
    bool "    断言信息中不使用文件名"
    depends on CONFIG_LIB_ASSERT

config CONFIG_LIB_DEALY
    bool "延时函数(udelay/mdelay)"
    default y

config CONFIG_LIB_RTC
    bool "时间转换函数(time_to_tm,tm_to_time...)"
    default y

config CONFIG_LIB_STRING
    bool "字符串操作函数(strcpy,strcmp...)"
    default y

config CONFIG_LIB_DUMP_MEM
    bool "打印内存函数(dump_mem)"
    default y

config CONFIG_LIB_XFORMAT
    bool "格式化字符串(xfromat)"

config CONFIG_LIB_XFORMAT_PRINTF
    bool "打印函数,基于xformat(printf,sprintf)"
    select CONFIG_LIB_XFORMAT

config CONFIG_LIB_RING_BUFFER
    bool "ring buffer(环形缓冲区)"

config CONFIG_DUMP_STACK
    bool "打印函数调用栈（异常时会自动打印）"
    default y
    select CONFIG_SYMBOLS
    select CONFIG_FUNC_SYMBOLS

source package/lib/sort.in

source package/lib/img_convert.in

config CONFIG_RING_MEM
    bool "ring mem(环形缓冲区)"

config CONFIG_LIB_NALU
    bool "nalu buf(h264 帧字节流解析)"

config CONFIG_UBOOT_LIB
    bool "rtos 跳转到 linux"

config CONFIG_LIB_CRC32
    bool "crc32函数"

config CONFIG_LIB_NV12_ROTATE
    bool "软件90°旋转 (仅nv12)"

config CONFIG_LIB_IMAGE_SCALER
    bool "图像缩放处理"

config CONFIG_LIB_IMAGE_MIRROR_C
    bool "图像镜像处理（C 版本）"
    help
        提供图像镜像处理功能（C 标准实现），支持：
        - 水平镜像（左右翻转）
        - 垂直镜像（上下翻转）
        - 旋转180度（水平+垂直镜像）
        支持 NV12/RGB 等多种格式（1/2/4/8 字节像素）
        兼容所有平台，性能适中，代码体积小

config CONFIG_LIB_IMAGE_MIRROR_MSA
    bool "图像镜像处理（MSA SIMD 加速版本）"
    depends on CONFIG_XBURST2_MSA
    help
        提供图像镜像处理功能（MSA SIMD 加速实现），支持：
        - 水平镜像（左右翻转）
        - 垂直镜像（上下翻转）
        使用 MSA SIMD 指令加速，性能提升 2-4 倍
        仅支持 XBurst2 架构且启用了 MSA 的平台
        可与 C 版本同时启用，用于性能对比

config CONFIG_LIB_IMAGE_ROTATE_MSA
    bool "图像旋转处理（MSA SIMD 加速版本）"
    depends on CONFIG_XBURST2_MSA
    help
        提供图像旋转处理功能（MSA SIMD 加速实现），支持：
        - 旋转90度
        - 旋转270度
        - 旋转180度（水平+垂直镜像）
        使用 MSA SIMD 指令加速，NV12图像性能提升60 - 70%
        仅支持 XBurst2 架构且启用了 MSA 的平台
        可与 C NV12 ROTATE同时启用，用于性能对比

config CONFIG_LIB_IMAGE_ROTATE_MIRROR_MSA
    bool "图像旋转镜像处理（MSA SIMD 加速版本）"
    depends on CONFIG_XBURST2_MSA
    select CONFIG_LIB_IMAGE_MIRROR_MSA
    select CONFIG_LIB_IMAGE_ROTATE_MSA
    help
        提供图像旋转+镜像处理功能（MSA SIMD 加速实现）
        相比分别调用旋转和镜像MSA接口，性能提升35 - 40%
        仅支持 XBurst2 架构且启用了 MSA 的平台
endmenu
```

## X2100_project-main/firmware/x2100/freertos/package/net/Config.in
```kconfig
menuconfig CONFIG_NET
    bool "Network"

menuconfig CONFIG_NET_LWIP
    bool "Enable lwIP stack"
    default n

config CONFIG_NET_LWIP_IPV6
    bool "Enable lwIP stack support IPV6"
    default n

config CONFIG_NET_LWIP_APPS
    bool "Enable lwIP stack apps"
    default n

endmenu

endmenu
```

## X2100_project-main/firmware/x2100/freertos/package/newlib/Config.in
```kconfig
menuconfig CONFIG_NEWLIB
    bool "c 标准库(newlib)"

config CONFIG_MIPS_SETJMP
    bool "MIPS setjmp/longjmp support"
    default n
    help
        使用 jz_setjmp.S 中的 MIPS 汇编实现替代工具链自带的 setjmp
        优化 o32 FPXX/FP64 模式下浮点寄存器 8 字节对齐问题

endmenu
```

## X2100_project-main/firmware/x2100/freertos/package/os/Config.in
```kconfig
menuconfig CONFIG_OS
    bool "操作系统"

source package/os/freertos/Config.in

source package/os/itos/Config.in

source package/os/posix/Config.in

config CONFIG_OS_MODULE
    bool "模块加载功能"
    depends on CONFIG_DFS_DEBUGFS
    help
     模块加载功能可以更好的解耦应用程序/os之间的联系，方便调试和产品发布

endmenu
```

## X2100_project-main/firmware/x2100/freertos/package/os/posix/Config.in
```kconfig
menuconfig CONFIG_OS_POSIX
    bool "使能 posix 定义的一系列接口 （使用os接口封装）"
    default y

config CONFIG_OS_POSIX_PTHREAD
    bool "pthread 相关接口"
    select CONFIG_OS_POSIX_CLOCK
    default y

config CONFIG_OS_POSIX_PTHREAD_MUTEX
    bool "pthread mutex 相关接口"
    select CONFIG_OS_POSIX_CLOCK
    default y

config CONFIG_OS_POSIX_PTHREAD_COND
    bool "pthread cond 相关接口"
    select CONFIG_OS_POSIX_PTHREAD_MUTEX
    default y

config CONFIG_OS_POSIX_PTHREAD_BARRIER
    bool "pthread barrier 相关接口"
    default y

config CONFIG_OS_POSIX_SEM
    bool "sem (信号量) 相关接口"
    select CONFIG_OS_POSIX_TIMER
    default y

config CONFIG_OS_POSIX_MQEUEUE
    bool "mqueue (消息队列) 相关接口"
    select CONFIG_OS_POSIX_TIMER
    default y

config CONFIG_OS_POSIX_TIMER
    bool "timer 相关接口"
    select CONFIG_OS_POSIX_CLOCK
    default y

config CONFIG_OS_POSIX_CLOCK
    bool "clock 相关接口"
    default y
    help
        clock_getcpuclockid
        clock_getres
        clock_gettime
        clock_nanosleep
        clock_settime
        nanosleep

config CONFIG_OS_POSIX_SCHED
    bool "sched 相关接口"
    default y
    help
        sched_get_priority_max
        sched_get_priority_min
        sched_yield

endmenu
```

## X2100_project-main/firmware/x2100/freertos/package/secureboot/Config.in
```kconfig
menuconfig CONFIG_SCBOOT
    bool "secureboot 安全启动"
    depends on CONFIG_SCBOOT_DRIVER
    default n

config CONFIG_SECURE_BOOT_KERNEL
    bool "kernel 验签+解密"
    default n

config CONFIG_CHECK_SIG_ROOTFS
    bool "rootfs 验签"
    default n

config CONFIG_RSA3072
    bool "使用rsa3072进行验签"
    default n

endmenu
```

## X2100_project-main/firmware/x2100/freertos/package/shell/Config.in
```kconfig
menuconfig CONFIG_SHELL
    bool "shell命令行"
    default y
    depends on CONFIG_DFS

endmenu
```

## X2100_project-main/firmware/x2100/freertos/package/symbols/Config.in
```kconfig
menuconfig CONFIG_SYMBOLS
    bool "符号相关选项"
    help
     主要用于查找和记录镜像中的符号，如果不确定，不用选择

config CONFIG_FUNC_SYMBOLS
    bool "记录相关函数的符号"

endmenu
```

## X2100_project-main/firmware/x2100/freertos/package/third_party/Config.in
```kconfig
menu "第三方软件列表"
source package/third_party/libstdc++/Config.in
source package/third_party/libcxx/Config.in
source package/third_party/libmad/Config.in
source package/third_party/faad2/Config.in
source package/third_party/libsamplerate/Config.in
source package/third_party/af_resample/Config.in
source package/third_party/freetype/Config.in
source package/third_party/awtk/Config.in
source package/third_party/memtester/Config.in
source package/third_party/libjpeg/Config.in
source package/third_party/jpeg-turbo/Config.in
source package/third_party/jpeg-tiny/Config.in
source package/third_party/libfacedet/Config.in
source package/third_party/libiaac/Config.in
source package/third_party/libgoodixTof/Config.in
source package/third_party/zlib/Config.in
source package/third_party/lrzsz/Config.in
source package/third_party/lvgl/Config.in
source package/third_party/lzma/Config.in
source package/third_party/speexdsp/Config.in
source package/third_party/notch_filter/Config.in
source package/third_party/mupdf/Config.in
endmenu
```

## X2100_project-main/firmware/x2100/freertos/package/third_party/awtk/Config.in
```kconfig
menuconfig CONFIG_AWTK
    bool "awtk"
    default n

menuconfig CONFIG_AWTK_DEFINE
    bool "awtk 可配置宏"
    default y

config CONFIG_AWTK_USE_GUI_MAIN
    bool "嵌入式系统有自己的main函数时"
    default y

config CONFIG_AWTK_WITH_BITMAP_FONT
    bool "支持预先解码的位图字体"
    default n

config CONFIG_AWTK_WITH_STB_IMAGE
    bool "支持png/jpeg图片"
    default y

config CONFIG_AWTK_WITH_STB_FONT
    bool "用stb支持Truetype字体"
    default y

config CONFIG_AWTK_WITH_FT_FONT
    bool "用freetype支持Truetype字体"
    default n

config CONFIG_AWTK_WITH_FS_RES
    bool "支持从文件系统加载资源"
    default n

config CONFIG_AWTK_APP_RES_ROOT
    string "指明资源所在的路径"
    default "/awtk"
    depends on CONFIG_AWTK_WITH_FS_RES

config CONFIG_AWTK_WITH_UNICODE_BREAK
    bool "使用标准的UNICODE换行算法"
    default y

config CONFIG_AWTK_WITH_BITMAP_BGRA
    bool "将图片解码成BGRA8888格式，否则解码成RGBA8888的格式"
    default y

config CONFIG_AWTK_WITH_BITMAP_BGR565
    bool "将不透明的PNG图片解码成BGR565格式,如果LCD是此格式,则可以提高性能"
    default n

config CONFIG_AWTK_WITH_BITMAP_RGB565
    bool "将不透明的PNG图片解码成RGB565格式,如果LCD是此格式,则可以提高性能"
    default n

config CONFIG_AWTK_WITH_NULL_IM
    bool "不需输入法"
    default y

config CONFIG_AWTK_HAS_STD_MALLOC
    bool "有标准的malloc/free/calloc等函数"
    default y

config CONFIG_AWTK_HAS_PTHREAD
    bool "有标准的pthread等函数"
    default y

config CONFIG_AWTK_HAS_STDIO
    bool "有标准的fopen/fclose等函数"
    default n

config CONFIG_AWTK_HAS_FAST_MEMCPY
    bool "有优化版本的memcpy函数"
    default y

config CONFIG_AWTK_WITH_NANOVG_AGGE
    bool "启用agge作为nanovg的后端(较agg作为后端：大(56KB编译后)，快，图形质量稍差)"
    select CONFIG_AWTK_WITH_3RD_NANOVG
    select CONFIG_AWTK_NANOVG_BACKEND_AGGE
    default y

config CONFIG_AWTK_WITH_NANOVG_AGG
    bool "启用agg作为nanovg的后端(较agge作为后端：小，慢，图形质量好)"
    default n
    select CONFIG_AWTK_WITH_3RD_NANOVG
    select CONFIG_AWTK_NANOVG_BACKEND_AGG

config CONFIG_AWTK_ENABLE_CURSOR
    bool "启用鼠标指针"
    default y

config CONFIG_AWTK_WITH_VGCANVAS_CAIRO
    bool "启用cairo作为nanovg的后端"
    default n
    select CONFIG_AWTK_WITH_3RD_NANOVG
    select CONFIG_AWTK_VGCANVAS_CAIRO

config CONFIG_AWTK_WITHOUT_WIDGET_ANIMATORS
    bool "不使用控件动画"
    default n

config CONFIG_AWTK_WITHOUT_WINDOW_ANIMATORS
    bool "不使用窗口动画"
    default n

config CONFIG_AWTK_WITHOUT_DIALOG_HIGHLIGHTER
    bool "不使用对话框高亮策略"
    default n

config CONFIG_AWTK_WITHOUT_EXT_WIDGETS
    bool "不使用扩展控件"
    default n

config CONFIG_AWTK_WITH_WIDGET_TYPE_CHECK
    bool "控件类型检查"
    default y

config CONFIG_AWTK_WITH_WCSXXX
    bool "出现wcsxxx之类的函数没有定义时，请定义该宏"
    default n

config CONFIG_AWTK_WITH_3RD_NANOVG
    bool

config CONFIG_AWTK_VGCANVAS_CAIRO
    bool

config CONFIG_AWTK_NANOVG_BACKEND_AGG
    bool

config CONFIG_AWTK_NANOVG_BACKEND_AGGE
    bool

endmenu # CONFIG_AWTK_DEFINE

endmenu # CONFIG_AWTK
```

## X2100_project-main/firmware/x2100/freertos/package/third_party/freetype/Config.in
```kconfig
menuconfig CONFIG_FREETYPE
    bool "freetype"
    default n
    help
      启用 FreeType 字体渲染库。

config CONFIG_FREETYPE_SMOOTH
    bool

config CONFIG_FREETYPE_RASTER
    bool

choice "选择 FreeType 默认启用的渲染器"
    default CONFIG_FREETYPE_RENDERER_SMOOTH

config CONFIG_FREETYPE_RENDERER_SMOOTH
    bool "Smooth (anti-aliased)"
    select CONFIG_FREETYPE_SMOOTH
    help
      启用灰度抗锯齿渲染，显示质量更高。

config CONFIG_FREETYPE_RENDERER_RASTER
    bool "Raster (monochrome)"
    select CONFIG_FREETYPE_RASTER
    help
      启用单色渲染，占用更小但有锯齿。

config CONFIG_FREETYPE_RENDERER_BOTH
    bool "Smooth + Raster"
    select CONFIG_FREETYPE_SMOOTH
    select CONFIG_FREETYPE_RASTER
    help
      同时启用两种渲染器。

endchoice

config CONFIG_FREETYPE_POSTSCRIPT_NAMES
    bool "PostScript glyph names"
    default n
    help
      支持 PS glyph name 与基于 PS 名称的 Unicode 合成。

config CONFIG_FREETYPE_GX_VAR
    bool "GX/variable font support"
    default n
    help
      启用可变字体（GX/Variable Fonts）支持。

config CONFIG_FREETYPE_SVG
    bool "SVG glyph support"
    default n
    help
      启用 OpenType SVG 字形支持（需外部 SVG 渲染回调）。

endmenu
```

## X2100_project-main/firmware/x2100/freertos/package/third_party/libcxx/Config.in
```kconfig
config CONFIG_LIBCXX
    bool "libcxx(c++ support) 未经严格测试,君正不做支持"
    select CONFIG_OS_HAS_CPP_SUPPORT
config CONFIG_LIBCXX_RTTI
    bool "    支持c++动态类型判断, typeid(dynamic_cast)"
    default n
    depends on CONFIG_LIBCXX
```

## X2100_project-main/firmware/x2100/freertos/package/third_party/libfacedet/Config.in
```kconfig
menuconfig CONFIG_LIBFACEDET
    bool "libfacedet"
    default n

choice "          选择人脸识别SDK"
    default CONFIG_LIBFACEDET_SDK

config CONFIG_LIBFACEDET_SDK
    bool "face_sdk"

config CONFIG_LIBFACEDET_SDK_MODEL_SEPARATE
    bool "face_sdk_model_separate"
    help
        "人脸识别模型分离"
endchoice

endmenu # CONFIG_LIBFACEDET
```
