## X2100_project-main/firmware/x2100/freertos/package/third_party/libsamplerate/Config.in
```kconfig
menuconfig CONFIG_LIBSAMPLERATE
    bool "libsamplerate(音频重采样)"
    default n

config CONFIG_LIBSAMPLERATE_HIGH_QUALITY
    bool "高阶算法(SINC 系列)"
    default n

endmenu
```

## X2100_project-main/firmware/x2100/freertos/package/third_party/libstdc++/Config.in
```kconfig
config CONFIG_LIBSTDCPP
    bool "libstdc++(c++ support) 未经严格测试,君正不做支持"
    select CONFIG_OS_HAS_CPP_SUPPORT
```

## X2100_project-main/firmware/x2100/freertos/package/third_party/mupdf/Config.in
```kconfig
config CONFIG_MUPDF
    bool "MUPDF (pdf 编解码/解析)"
    default n
    select CONFIG_MIPS_SETJMP
```

## X2100_project-main/firmware/x2100/freertos/package/xburst/Config.in
```kconfig
menuconfig CONFIG_XBURST
    bool "xburst系列cpu"
    select CONFIG_MIPS32

choice "选择具体的cpu/soc"

config CONFIG_XBURST_X1000
    bool "x1000"
    select CONFIG_SOC_X1000S
    select CONFIG_SOC_X1000_X1000

config CONFIG_XBURST_X1500L
    bool "x1500l (x1000系列)"
    select CONFIG_SOC_X1000S
    select CONFIG_SOC_X1000_X1500L

config CONFIG_XBURST_X1500
    bool "x1500 (x1000系列)"
    select CONFIG_SOC_X1000S
    select CONFIG_SOC_X1000_X1500

config CONFIG_XBURST_X1021
    bool "x1021"
    select CONFIG_SOC_X1021S
    select CONFIG_SOC_X1021_X1021

config CONFIG_XBURST_X1521
    bool "x1521 (x1021系列)"
    select CONFIG_SOC_X1021S
    select CONFIG_SOC_X1021_X1521

config CONFIG_XBURST_X1520
    bool "x1520"
    select CONFIG_SOC_X1520

config CONFIG_XBURST_X1600
    bool "x1600"
    select CONFIG_SOC_X1600S
    select CONFIG_SOC_X1600_X1600

config CONFIG_XBURST_X1660
    bool "x1660 (x1600系列)"
    select CONFIG_SOC_X1600S
    select CONFIG_SOC_X1600_X1660

config CONFIG_XBURST_X1630
    bool "x1630 (x1830系列)"
    select CONFIG_SOC_X1830S
    select CONFIG_SOC_X1830_X1630

config CONFIG_XBURST_X1830
    bool "x1830"
    select CONFIG_SOC_X1830S
    select CONFIG_SOC_X1830_X1830

endchoice

config CONFIG_CP0_TIMER
    bool "cpu 自带的定时器"
    help
        x1000以及x1000以前的芯片应该是没有

source package/xburst/soc-x1000/Config.in
source package/xburst/soc-x1021/Config.in
source package/xburst/soc-x1520/Config.in
source package/xburst/soc-x1600/Config.in
source package/xburst/soc-x1830/Config.in

config CONFIG_EXTAL_CLOCK
    int "cpu 外部主晶振频率"
    default 24000000

config CONFIG_XBURST_RTC_32K
    bool "外接 32.768K 晶振"

config BITS_PER_LONG
    int
    default 32

config CONFIG_XBURST_IRQ
    bool "irq中断支持"
    select CONFIG_IRQ
    default y

config CONFIG_XBURST_CACHE
    bool "cache缓存支持"
    select CONFIG_CACHE
    default y

config CONFIG_XBURST_SPINLOCK
    bool "spinlock自旋锁支持"
    select CONFIG_SPINLOCK
    default y

config CONFIG_XBURST_CLK
    bool "时钟驱动"
    select CONFIG_CLK
    default y

config CONFIG_XBURST_SYSTICK
    bool "ost timer(操作系统时钟源)"
    select CONFIG_SYSTICK
    default y

config CONFIG_XBURST_GPIO
    bool "gpio驱动"
    select CONFIG_GPIO
    default y

config CONFIG_XBURST_DMA
    bool "dma驱动"
    select CONFIG_DMA
    default y

endmenu
```

## X2100_project-main/firmware/x2100/freertos/package/xburst/soc-x1000/Config.in
```kconfig
config CONFIG_SOC_X1000S
    bool
    select CONFIG_SOC_X1000

menuconfig CONFIG_SOC_X1000
    bool "x1000系列 cpu 设置"
    depends on CONFIG_SOC_X1000S

menuconfig CONFIG_SOC_X1000_X1000
    bool
    depends on CONFIG_XBURST_X1000
    select CONFIG_SOC_X1000_HAS_LCD

source package/xburst/soc-x1000/x1000-spl.in
source package/xburst/soc-x1000/x1000-gpio.in


endmenu


menuconfig CONFIG_SOC_X1000_X1500L
    bool
    depends on CONFIG_XBURST_X1500L

source package/xburst/soc-x1000/x1500l-spl.in
source package/xburst/soc-x1000/x1500l-gpio.in

endmenu

menuconfig CONFIG_SOC_X1000_X1500
    bool
    depends on CONFIG_XBURST_X1500

source package/xburst/soc-x1000/x1500-spl.in
source package/xburst/soc-x1000/x1500-gpio.in

endmenu

source package/xburst/soc-x1000/uart.in

source package/xburst/soc-x1000/spi.in

source package/xburst/soc-x1000/i2c.in

source package/xburst/soc-x1000/mmc/mmc.in

source package/xburst/soc-x1000/cim.in

source package/xburst/soc-x1000/pcm.in

source package/xburst/soc-x1000/utils.in

config CONFIG_X1000_DMIC
    bool "dmic(外接数字mic)"
    select CONFIG_PCM

config CONFIG_X1000_PWM
    bool "pwm (脉宽调制)"
    select CONFIG_PWM

config CONFIG_X1000_WDT
    bool "watchdog(看门狗)"
    select CONFIG_WDT

config CONFIG_X1000_RTC
    bool "rtc (墙上时间)"
    select CONFIG_RTC

config CONFIG_X1000_AES
    bool "aes（加解密）"
    select CONFIG_AES

config CONFIG_X1000_SECURITY_AES
    bool "security aes (加解密)"
    select CONFIG_SECURITY_AES

menuconfig CONFIG_X1000_EFUSE
    bool "efuse (芯片熔丝内容)"
    select CONFIG_EFUSE
    select CONFIG_GPIO_PIN

config CONFIG_X1000_EFUSE_VDDQ
    string "EFUSE_VDDQ"
    choice from SOC_GPIO_PIN_LEVELS
    default -1,0

endmenu # CONFIG_X1000_EFUSE

config CONFIG_X1000_PM
    bool "休眠功能"
    select CONFIG_PM

config CONFIG_X1000_TCU
    bool "TCU(Timer/Counter Unit)"

source package/xburst/soc-x1000/lcd.in

source package/xburst/soc-x1000/mac/mac.in

endmenu
```

## X2100_project-main/firmware/x2100/freertos/package/xburst/soc-x1021/Config.in
```kconfig
config CONFIG_SOC_X1021S
    bool
    select CONFIG_SOC_X1021

menuconfig CONFIG_SOC_X1021
    bool "x1021系列 cpu 设置"
    depends on CONFIG_SOC_X1021S

menuconfig CONFIG_SOC_X1021_X1021
    bool
    depends on CONFIG_XBURST_X1021

source package/xburst/soc-x1021/x1021-spl.in

endmenu

menuconfig CONFIG_SOC_X1021_X1521
    bool
    depends on CONFIG_XBURST_X1521

source package/xburst/soc-x1021/x1521-spl.in

endmenu

source package/xburst/soc-x1021/uart.in

source package/xburst/soc-x1021/gpio.in

source package/xburst/soc-x1021/spi.in

source package/xburst/soc-x1021/i2c.in

source package/xburst/soc-x1021/pcm.in

source package/xburst/soc-x1021/vic.in

config CONFIG_X1021_ADC
    bool "adc (电压采样)"
    select CONFIG_ADC

config CONFIG_X1021_PWM
    bool "pwm (脉宽调制)"
    select CONFIG_PWM

config CONFIG_X1021_WDT
    bool "watchdog(看门狗)"
    select CONFIG_WDT

config CONFIG_X1021_RTC
    bool "rtc (墙上时间)"
    select CONFIG_RTC

config CONFIG_X1021_DTRNG
    bool "dtrng (硬件随机数产生)"
    select CONFIG_DTRNG

menuconfig CONFIG_X1021_EFUSE
    bool "efuse (芯片熔丝内容)"
    select CONFIG_EFUSE

config CONFIG_X1021_EFUSE_VDDQ
    string "EFUSE_VDDQ"
    default -1
    choice from SOC_GPIO_PINS

endmenu # CONFIG_X1021_EFUSE

config CONFIG_X1021_TCU
    bool "TCU(Timer/Counter Unit)"

source package/xburst/soc-x1021/lcd.in

endmenu # CONFIG_SOC_X1021
```

## X2100_project-main/firmware/x2100/freertos/package/xburst/soc-x1520/Config.in
```kconfig
menuconfig CONFIG_SOC_X1520
    bool "x1520 cpu 设置"
    depends on CONFIG_XBURST_X1520

source package/xburst/soc-x1520/spl.in

source package/xburst/soc-x1520/gpio.in

source package/xburst/soc-x1520/uart.in

source package/xburst/soc-x1520/spi.in

source package/xburst/soc-x1520/i2c.in

source package/xburst/soc-x1520/vic.in

source package/xburst/soc-x1520/pcm.in

config CONFIG_X1520_ADC
    bool "adc (电压采样)"
    select CONFIG_ADC

config CONFIG_X1520_PWM
    bool "pwm (脉宽调制)"
    select CONFIG_PWM

config CONFIG_X1520_WDT
    bool "watchdog(看门狗)"
    select CONFIG_WDT

config CONFIG_X1520_RTC
    bool "rtc (墙上时间)"
    select CONFIG_RTC

config CONFIG_X1520_DTRNG
    bool "dtrng (硬件随机数产生)"
    select CONFIG_DTRNG

menuconfig CONFIG_X1520_EFUSE
    bool "efuse (芯片熔丝内容)"
    select CONFIG_EFUSE

config CONFIG_X1520_EFUSE_VDDQ
    string "EFUSE_VDDQ"
    default -1
    choice from SOC_GPIO_PINS

endmenu # CONFIG_X1520_EFUSE

config CONFIG_X1520_PM
    bool "休眠功能"
    select CONFIG_PM

config CONFIG_X1520_TCU
    bool "TCU(Timer/Counter Unit)"

endmenu # CONFIG_SOC_X1520
```

## X2100_project-main/firmware/x2100/freertos/package/xburst/soc-x1600/Config.in
```kconfig
config CONFIG_SOC_X1600S
    bool
    select CONFIG_SOC_X1600

menuconfig CONFIG_SOC_X1600
    bool "x1600系列 cpu 设置"
    depends on CONFIG_SOC_X1600S

menuconfig CONFIG_SOC_X1600_X1600
    bool
    depends on CONFIG_XBURST_X1600
    select CONFIG_SOC_X1600_UART

source package/xburst/soc-x1600/x1600-gpio.in


endmenu

menuconfig CONFIG_SOC_X1600_X1660
    bool
    depends on CONFIG_XBURST_X1660
    select CONFIG_SOC_X1660_UART

source package/xburst/soc-x1600/x1660-gpio.in

endmenu


source package/xburst/soc-x1600/uart.in

source package/xburst/soc-x1600/i2c.in

source package/xburst/soc-x1600/spi.in

source package/xburst/soc-x1600/sslv.in

source package/xburst/soc-x1600/mmc/mmc.in

source package/xburst/soc-x1600/camera/camera.in

source package/xburst/soc-x1600/lcd.in

source package/xburst/soc-x1600/utils.in

source package/xburst/soc-x1600/pcm.in

source package/xburst/soc-x1600/can.in

config CONFIG_X1600_PWM
    bool "pwm (脉宽调制)"
    select CONFIG_PWM
    select CONFIG_DMA

config CONFIG_X1600_ADC
    bool "adc (电压采样)"
    select CONFIG_ADC

config CONFIG_X1600_AES
    bool "aes (编解码)"
    select CONFIG_AES

config CONFIG_X1600_WDT
    bool "watchdog(看门狗)"
    select CONFIG_WDT

config CONFIG_X1600_RTC
    bool "rtc (墙上时间)"
    select CONFIG_RTC

config CONFIG_X1600_DTRNG
    bool "dtrng 驱动(获取随机数功能)"
    select CONFIG_DTRNG

config CONFIG_X1600_HASH
    bool "hash 驱动(数据加密)"
    select CONFIG_HASH

menuconfig CONFIG_X1600_EFUSE
    bool "efuse (芯片熔丝内容)"
    select CONFIG_EFUSE
    select CONFIG_GPIO_PIN

config CONFIG_X1600_EFUSE_VDDQ
    string "EFUSE_VDDQ"
    choice from SOC_GPIO_PIN_LEVELS
    default -1,0

endmenu # CONFIG_X1600_EFUSE

config CONFIG_X1600_PM
    bool "休眠功能"
    select CONFIG_PM

config CONFIG_X1600_TCU
    bool "TCU(Timer/Counter Unit)"

config CONFIG_X1600_SCBOOT_DRIVER
    bool "secure boot 驱动"
    select CONFIG_SCBOOT_DRIVER
    default n

source package/xburst/soc-x1600/mac/mac.in

endmenu
```

## X2100_project-main/firmware/x2100/freertos/package/xburst/soc-x1830/Config.in
```kconfig
config CONFIG_SOC_X1830S
    bool
    select CONFIG_SOC_X1830

menuconfig CONFIG_SOC_X1830
    bool "x1830系列 cpu 设置"
    depends on CONFIG_SOC_X1830S

menuconfig CONFIG_SOC_X1830_X1830
    bool
    depends on CONFIG_XBURST_X1830

source package/xburst/soc-x1830/x1830-spl.in
source package/xburst/soc-x1830/x1830-gpio.in

endmenu

menuconfig CONFIG_SOC_X1830_X1630
    bool
    depends on CONFIG_XBURST_X1630

source package/xburst/soc-x1830/x1630-spl.in
source package/xburst/soc-x1830/x1630-gpio.in

endmenu


source package/xburst/soc-x1830/uart.in

source package/xburst/soc-x1830/gpio.in

source package/xburst/soc-x1830/spi.in

source package/xburst/soc-x1830/i2c.in

source package/xburst/soc-x1830/pcm.in

source package/xburst/soc-x1830/mscaler.in

config CONFIG_X1830_DMIC
    bool "dmic(外接数字mic)"
    select CONFIG_PCM

source package/xburst/soc-x1830/vic.in

source package/xburst/soc-x1830/lcd.in

config CONFIG_X1830_ADC
    bool "adc (电压采样)"
    select CONFIG_ADC

config CONFIG_X1830_PWM
    bool "pwm (脉宽调制)"
    select CONFIG_PWM

config CONFIG_X1830_WDT
    bool "watchdog(看门狗)"
    select CONFIG_WDT

config CONFIG_X1830_RTC
    bool "rtc (墙上时间)"
    select CONFIG_RTC

config CONFIG_X1830_DTRNG
    bool "dtrng (硬件随机数产生)"
    select CONFIG_DTRNG

config CONFIG_X1830_DES
    bool "des (数据加密器)"
    select CONFIG_DES

menuconfig CONFIG_X1830_EFUSE
    bool "efuse (芯片熔丝内容)"
    select CONFIG_EFUSE

config CONFIG_X1830_EFUSE_VDDQ
    string "EFUSE_VDDQ"
    default -1
    choice from SOC_GPIO_PINS

endmenu # CONFIG_X1830_EFUSE

config CONFIG_X1830_TCU
    bool "TCU(Timer/Counter Unit)"

endmenu # CONFIG_SOC_X1830
```

## X2100_project-main/firmware/x2100/freertos/package/xburst2/Config.in
```kconfig
menuconfig CONFIG_XBURST2
    bool "xburst2系列cpu"
    select CONFIG_MIPS32

choice "选择具体的cpu/soc"

config CONFIG_XBURST2_X2000
    bool "x2000"
    select CONFIG_SOC_X2000S
    select CONFIG_SOC_X2000_X2000

config CONFIG_XBURST2_X2100
    bool "x2100 (x2000系列)"
    select CONFIG_SOC_X2000S
    select CONFIG_SOC_X2000_X2100

config CONFIG_XBURST2_X2600
    bool "x2600"
    select CONFIG_SOC_X2600S
    select CONFIG_SOC_X2600_X2600
    select CONFIG_USB1_HOST_SUPPORT

config CONFIG_XBURST2_X2670
    bool "x2670(x2600系列)"
    select CONFIG_SOC_X2600S
    select CONFIG_SOC_X2600_X2670
    select CONFIG_USB1_HOST_SUPPORT

config CONFIG_XBURST2_AD100
    bool "ad100"
    select CONFIG_SOC_AD100S
    select CONFIG_SOC_AD100_AD100

config CONFIG_XBURST2_AD101
    bool "ad101(ad100系列)"
    select CONFIG_SOC_AD100S
    select CONFIG_SOC_AD100_AD101

config CONFIG_XBURST2_AD102N
    bool "ad102n(ad100系列)"
    select CONFIG_SOC_AD100S
    select CONFIG_SOC_AD100_AD102N
    select CONFIG_USB1_HOST_SUPPORT

config CONFIG_XBURST2_AD102P
    bool "ad102p(ad100系列)"
    select CONFIG_SOC_AD100S
    select CONFIG_SOC_AD100_AD102P
    select CONFIG_USB1_HOST_SUPPORT

endchoice

config CONFIG_XBURST2_CP0_TIMER
    bool "cpu 自带的定时器"

config CONFIG_XBURST2_MSA
    bool "msa 指令支持(gcc -msa)"
    default y

source package/xburst2/soc-x2000/Config.in
source package/xburst2/soc-x2600/Config.in
source package/xburst2/soc-ad100/Config.in

config CONFIG_EXTAL_CLOCK
    int "cpu 外部主晶振频率"
    default 24000000

config CONFIG_XBURST2_RTC_32K
    bool "外接 32.768K 晶振"

config BITS_PER_LONG
    int
    default 32

config CONFIG_XBURST2_IRQ
    bool "irq中断支持"
    select CONFIG_IRQ
    default y

config CONFIG_XBURST2_CACHE
    bool "cache缓存支持"
    select CONFIG_CACHE
    default y

config CONFIG_XBURST2_SPINLOCK
    bool "spinlock自旋锁支持"
    select CONFIG_SPINLOCK
    default y

config CONFIG_XBURST2_CLK
    bool "时钟驱动"
    select CONFIG_CLK
    default y

config CONFIG_XBURST2_SYSTICK
    bool "ost timer(操作系统时钟源)"
    select CONFIG_SYSTICK
    default y

config CONFIG_XBURST2_GPIO
    bool "gpio驱动"
    select CONFIG_GPIO
    default y

config CONFIG_XBURST2_DMA
    bool "dma驱动"
    select CONFIG_DMA
    default y

endmenu
```
